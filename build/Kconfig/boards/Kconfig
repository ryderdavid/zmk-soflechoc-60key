## build/Kconfig/boards/Kconfig
```kconfig
# Load Zephyr board Kconfig descriptions.
osource "/workspace/zmk/app/boards/nicekeyboards/nice_nano/Kconfig"
```

## build/Kconfig/boards/Kconfig.nice_nano
```kconfig
# Load board Kconfig descriptions.
osource "/workspace/zmk/app/boards/nicekeyboards/nice_nano/Kconfig.nice_nano"
```

## build/Kconfig/boards/Kconfig.sysbuild
```kconfig
# Load Sysbuild board Kconfig descriptions.
osource "/workspace/zmk/app/boards/nicekeyboards/nice_nano/Kconfig.sysbuild"
```

## config/west.yml
```yaml
manifest:
  remotes:
    - name: zmkfirmware
      url-base: https://github.com/zmkfirmware
    - name: urob
      url-base: https://github.com/urob
  projects:
    - name: zmk
      remote: zmkfirmware
      revision: ac7f75b  # pinned: last known-good before nice_view_spi breakage (2026-01-29)
      import: app/west.yml
    - name: zmk-adaptive-key
      remote: urob
      revision: main
    - name: zmk-leader-key
      remote: urob
      revision: main
    - name: zmk-tri-state
      remote: urob
      revision: main
    - name: zmk-auto-layer
      remote: urob
      revision: main
    - name: zmk-helpers
      remote: urob
      revision: main
  self:
    path: config
```
